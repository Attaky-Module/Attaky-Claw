## application/edge_agent/boards/attaky/agent_deck_1_0/sdkconfig.defaults.board
```kconfig
CONFIG_ESP_DEFAULT_CPU_FREQ_MHZ_240=y

# Core ESP32 1.0 uses ESP32-S3-WROOM-1U-N16R8: 16 MB QIO flash @ 80 MHz
CONFIG_ESPTOOLPY_FLASHMODE_QIO=y
CONFIG_ESPTOOLPY_FLASHFREQ_80M=y
CONFIG_ESPTOOLPY_FLASHSIZE_16MB=y
CONFIG_PARTITION_TABLE_CUSTOM=y
CONFIG_PARTITION_TABLE_CUSTOM_FILENAME="partitions_16MB.csv"

# N16R8: 8 MB octal PSRAM @ 80 MHz
CONFIG_SPIRAM=y
CONFIG_SPIRAM_MODE_OCT=y
CONFIG_SPIRAM_SPEED_80M=y

# Audio: NS4168 speaker and ICS-43434 mic are codec-less I2S devices,
# handled through the dummy codec driver.
CONFIG_ESP_BOARD_PERIPH_I2S_SUPPORT=y
CONFIG_CODEC_DUMMY_SUPPORT=y

# Console runs over the CH340X USB-to-UART bridge on UART0 (TXD0/RXD0).
CONFIG_ESP_CONSOLE_UART_DEFAULT=y

# Emote canvas background: pure black (project default is dark-gray
# 0x171617). With invert_color:true this renders as true black.
CONFIG_EMOTE_DEF_BG_COLOR=0x000000

CONFIG_LOG_DEFAULT_LEVEL_INFO=y
```

## components/common/emote/Kconfig
```kconfig
menu "Emote"

    config APP_EMOTE_DEBUG_CONSOLE
        bool "On-device emote debug console"
        default y
        help
            Register the `emote` serial console command and the
            emote_debug_show/event/bat helpers used to review faces,
            state events (listen/speak/idle) and battery rendering
            directly on hardware. Intended for development builds;
            disable for release images to drop the debug surface.

endmenu
```
